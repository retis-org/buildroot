## configs/retis_qemu_aarch64_virt_defconfig
```kconfig
BR2_aarch64=y
BR2_TOOLCHAIN_EXTERNAL=y
BR2_TOOLCHAIN_EXTERNAL_BOOTLIN=y
BR2_CCACHE=y
BR2_CCACHE_DIR="$(TOPDIR)/output/.buildroot-ccache"
BR2_GLOBAL_PATCH_DIR="board/qemu/patches"
BR2_DOWNLOAD_FORCE_CHECK_HASHES=y
BR2_SYSTEM_DHCP="eth0"
BR2_ROOTFS_POST_BUILD_SCRIPT="board/retis/post-build.sh"
BR2_ROOTFS_POST_IMAGE_SCRIPT="board/qemu/post-image.sh"
BR2_ROOTFS_POST_SCRIPT_ARGS="$(BR2_DEFCONFIG)"
BR2_LINUX_KERNEL=y
BR2_LINUX_KERNEL_USE_CUSTOM_CONFIG=y
BR2_LINUX_KERNEL_CUSTOM_CONFIG_FILE="board/retis/aarch64-virt/linux.config"
BR2_LINUX_KERNEL_NEEDS_HOST_OPENSSL=y
BR2_LINUX_KERNEL_NEEDS_HOST_PAHOLE=y
BR2_PACKAGE_BUSYBOX_SHOW_OTHERS=y
BR2_PACKAGE_RETIS=y
BR2_PACKAGE_CONNTRACK_TOOLS=y
BR2_PACKAGE_IPERF3=y
BR2_PACKAGE_IPROUTE2=y
BR2_PACKAGE_NFTABLES=y
BR2_PACKAGE_NMAP=y
BR2_PACKAGE_NMAP_NCAT=y
BR2_PACKAGE_TCPDUMP=y
BR2_TARGET_ROOTFS_EXT2=y
BR2_TARGET_ROOTFS_EXT2_4=y
# BR2_TARGET_ROOTFS_TAR is not set
BR2_PACKAGE_HOST_QEMU=y
BR2_PACKAGE_HOST_QEMU_SYSTEM_MODE=y
```

## package/retis/Config.in
```kconfig
config BR2_PACKAGE_RETIS
	bool "retis"
	depends on BR2_PACKAGE_HOST_RUSTC_TARGET_ARCH_SUPPORTS
	depends on BR2_i386 || BR2_86_64 || BR2_aarch64
	select BR2_PACKAGE_HOST_CLANG
	select BR2_PACKAGE_HOST_JQ
	select BR2_PACKAGE_HOST_LLVM
	select BR2_PACKAGE_HOST_RUSTC
	select BR2_PACKAGE_ELFUTILS
	select BR2_PACKAGE_LIBPCAP
	select BR2_PACKAGE_PYTHON3
	select BR2_PACKAGE_ZLIB
	help
	  Tracing packets in the Linux networking stack.

	  https://retis.readthedocs.io/
```
